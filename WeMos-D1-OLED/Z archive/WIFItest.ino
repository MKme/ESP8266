#include <ESP8266WiFi.h>
#include <Wire.h>
#include <SPI.h>
#include "SSD1306.h"
#include "SSD1306Ui.h"

// Pin definitions for I2C
#define OLED_SDA    D2  // pin 14
#define OLED_SDC    D1  // pin 12
#define OLED_ADDR   0x3C

SSD1306   display(OLED_ADDR, OLED_SDA, OLED_SDC);    // For I2C
SSD1306Ui ui     ( &display );

const char* ssid     = "xxxx";
const char* password = "xxxx";

char servername[]="educ8s.tv";  // remote server we will connect to

WiFiClient client;

String result;
static const char icon [] PROGMEM =
{
0x00, 0x00, 0x00, 0x00, 0x00, 0x00, 0x00, 0x00, 0x00, 0x00, 0x00, 0xF8,
  0x00, 0x00, 0x00, 0x00, 0x00, 0x00, 0x80, 0xFF, 0x07, 0x00, 0x00, 0x00,
  0x00, 0x00, 0xE0, 0xFF, 0x1F, 0x00, 0x00, 0x00, 0x00, 0x00, 0xF8, 0xFF,
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  0x00, 0x00, 0x00, 0x00, 0x00, 0x00, 0x00, 0x00, 0x00, 0x00, 0x00, 0x00,
 
};

void deleteHttpHeader()
{
if(result.endsWith("Accept-Encoding"))
{
  result="";
}

}

void sendGET() //client function to send/receive GET request data.
{
  if (client.connect(servername, 80)) {  //starts client connection, checks for connection
    Serial.println("connected");
    client.println("GET /test.txt HTTP/1.1"); //download text
    client.println("Host: educ8s.tv");
    client.println("Connection: close");  //close 1.1 persistent connection  
    client.println(); //end of get request
  } 
  else {
    Serial.println("connection failed"); //error message if no client connect
    Serial.println();
  }

  while(client.connected() && !client.available()) delay(1); //waits for data
  while (client.connected() || client.available()) { //connected or data available
    char c = client.read(); //gets byte from ethernet buffer
    result = result+c;
    deleteHttpHeader();
  }
  result.trim();
  Serial.println(result);
  display.clear();
  display.setFont(ArialMT_Plain_16);
  display.drawString(0,0,result);
  display.display();
  client.stop(); //stop client
}


void setup() {
  Serial.begin(115200);
  ui.init();
  display.flipScreenVertically();
  display.drawXbm(35,15,60,36,icon);
  display.display();
  delay(4000);

  Serial.println();
  Serial.println();
  Serial.print("Connecting to ");
  Serial.println(ssid);
  display.clear();
  display.setFont(ArialMT_Plain_16);
  display.drawString(0,0, "Connecting...");
  display.display(); 
  WiFi.begin(ssid, password);
  
  while (WiFi.status() != WL_CONNECTED) {
    delay(500);
    Serial.print(".");
  }

  Serial.println("");
  display.clear();
  display.drawString(0,0, "Connected!");
  display.drawString(0,20, "Getting text...");
  display.display(); 

}


void loop() {
  result="";
  delay(5000);  
  sendGET();
}


